// SPDX-License-Identifier: GPL-2.0-only
/dts-v1/;
/plugin/;

/* Offline experiment only. Not a replacement for the active DTBO. */
/ {
	qcom,msm-id = <365 0>;
	qcom,board-id = <34 0>;
};

&soc {
	/* Wiring and supplies are defined by the matching 6.1 base. */
	ufshc@1d84000 {
		status = "okay";
	};

	ufsphy_mem@1d87000 {
		status = "okay";
	};
};
