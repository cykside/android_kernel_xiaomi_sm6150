// SPDX-License-Identifier: GPL-2.0-only

/* Stock J20 touch bus. SE0 is still assigned to the base debug UART. */
&qupv3_0 {
	spi@880000 {
		compatible = "qcom,spi-geni";
		reg = <0x880000 0x4000>;
		reg-names = "se_phys";
		#address-cells = <1>;
		#size-cells = <0>;
		clocks = <&gcc GCC_QUPV3_WRAP0_S0_CLK>;
		clock-names = "se-clk";
		interconnects = <&aggre1_noc MASTER_QUP_0 &mc_virt SLAVE_EBI1>,
				<&gem_noc MASTER_APPSS_PROC &config_noc SLAVE_QUP_0>,
				<&aggre1_noc MASTER_QUP_0 &mc_virt SLAVE_EBI1>;
		interconnect-names = "qup-core", "qup-config", "qup-memory";
		interrupts = <GIC_SPI 601 IRQ_TYPE_LEVEL_HIGH>;
		spi-max-frequency = <50000000>;
		status = "disabled";

		touchscreen@0 {
			compatible = "novatek,NVT-ts-spi";
			reg = <0>;
			spi-max-frequency = <19200000>;
			touch_vddio-supply = <&pm6150_l18>;
			touch_lab-supply = <&lcdb_ldo_vreg>;
			touch_ibb-supply = <&lcdb_ncp_vreg>;
			/* Preserve the legacy GPIO flags until the driver is ported. */
			novatek,reset-gpio = <&tlmm 8 0x0>;
			novatek,irq-gpio = <&tlmm 9 0x2001>;
			novatek,swrst-n8-addr = <0x03f0fe>;
			novatek,spi-rd-fast-addr = <0x03f310>;
			status = "disabled";
		};
	};
};
